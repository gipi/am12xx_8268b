## case/project_kit/project_ezcastpro/batch/am_pipe/Kconfig
```kconfig
#
# TEST card drivers
#

config AM_PIPE_DEV
	tristate "AM PIPE device driver"
	depends on BLOCK
	default y
	help
	  Say Y here to enable the AM PIPE device.
```

## case/project_kit/project_ezcastpro/batch/uartcom/Kconfig
```kconfig
#
# TEST card drivers
#

config UART_COM
	tristate "Using uart to communicate"
	depends on BLOCK
	default y
	help
	  Say Y here to enable the UART communication
```

## sdk/linux/drivers/card/Kconfig
```kconfig
#
# MMC subsystem configuration
#

menuconfig AM7X_CRC
	bool "AM7XXX Card Reader Controler support"
	depends on HAS_IOMEM
	select AM7X_CRC_CORE
	help
	  MMC is the "multi-media card" bus protocol.

	  If you want MMC support, you should say Y here and also
	  to the specific driver for your MMC interface.

if AM7X_CRC


config AM7X_CRC_CORE
	bool
	
endif # CRC_CARD
```

## sdk/linux/drivers/mtd/am7x_nftl/Kconfig
```kconfig
config AM_NFTL
	tristate "AM7XXXX NFTL (NAND Flash Translation Layer) support"
	depends on BLOCK && AM_MIPS && !NFTL
	select MTD_BLKDEVS
	---help---
	Say Y here to enable the ActionsMicro NFTL driver support on
	AM7XXXX evulation board.
```

## sdk/linux/drivers/net/ksz884x/Kconfig
```kconfig
#
# KS884X network device configuration
#


config KS884X
	bool "KS8841/2 Ethernet controller support"
	depends on NET_ETHERNET
	help
	  Micrel KS8841/2 Ethernet controller support.
```
